## sdkconfig.defaults
```kconfig
# ESP32-C3 ESP-IDF 配置
CONFIG_IDF_TARGET="esp32c3"

# 分区表
CONFIG_PARTITION_TABLE_CUSTOM=y
CONFIG_PARTITION_TABLE_CUSTOM_FILENAME="partitions_ota.csv"

# WiFi
CONFIG_ESP_WIFI_ENABLED=y
CONFIG_ESP_WIFI_STA_DISCONNECTED_PM_ENABLE=y

# WebSocket
CONFIG_ESP_WEBSOCKET_ENABLED=y

# 日志
CONFIG_LOG_DEFAULT_LEVEL_INFO=y

# I2S
CONFIG_I2S_ENABLED=y

# OTA
CONFIG_ESP_HTTPS_OTA_ENABLED=y

# 提高 WiFi 稳定性
CONFIG_ESP_WIFI_IRAM_OPT=y
CONFIG_ESP_WIFI_RX_IRAM_OPT=y
```
